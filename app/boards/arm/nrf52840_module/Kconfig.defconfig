## app/boards/arm/nrf52840_module/Kconfig.defconfig
```kconfig
# nRF52840 module board configuration

# Copyright (c) 2016 Nordic Semiconductor ASA
# SPDX-License-Identifier: Apache-2.0

if BOARD_NRF52840_MODULE

config BOARD
	default "nrf52840_module"

#if ADC
#
#config ADC_0
#	default y
#
#endif # ADC

if I2C

config I2C_0
	default y

endif # I2C

#if PWM
#
#config PWM_0
#	default y
#
#endif # PWM

if SPI

config SPI_1
	default y

config SPI_2
	default y

config SPI_3
	default y

endif # SPI

if USB

config USB_NRFX
	default y

config USB_DEVICE_STACK
	default y

endif # USB

config BT_CTLR
	default BT

config ZMK_KEYBOARD_NAME
	default "K68"

config ZMK_USB
	default y

config ZMK_BLE
	default y

#config ZMK_KSCAN_MATRIX_POLLING
#    default y

endif # BOARD_NRF52840_MODULE
```
